## conf/distro/nolix.conf
```bitbake
require conf/distro/poky.conf

DESCRIPTION = "Custom Linux Distro For Nol Yocto Project"

DISTRO = "nolix"
DISTRO_NAME = "Nolix (Nol Yocto Project Distro)"
NOLIX_DISTRO_VERSION = "1.0"
DISTRO_VERSION = "${NOLIX_DISTRO_VERSION}"
DISTRO_CODENAME = "master"

SDK_VENDOR = "-nolixsdk"
SDK_VERSION := "${DISTRO_VERSION}"

MAINTAINER = "Mr Nol <hakanbrolin@yhotmail.com>"

TARGET_VENDOR = "-nolix"

# Use systemd as default init manager
DISTRO_FEATURES_append = " systemd"
DISTRO_FEATURES_BACKFILL_CONSIDERED = "sysvinit"
VIRTUAL-RUNTIME_init_manager = "systemd"
VIRTUAL-RUNTIME_initscripts = ""

# Remove stuff not used
DISTRO_FEATURES_remove = "x11 wayland ipv6 "

# Prevent installation of recommended-only packages
NO_RECOMMENDATIONS = "1"
```

## conf/layer.conf
```bitbake
# We have a conf and classes directory, add to BBPATH
BBPATH .= ":${LAYERDIR}"

# We have a packages directory, add to BBFILES
BBFILES += "${LAYERDIR}/recipes-*/*/*.bb \
            ${LAYERDIR}/recipes-*/*/*.bbappend \
            ${LAYERDIR}/recipes-*/*/*/*.bb \
            ${LAYERDIR}/recipes-*/*/*/*.bbappend \
            ${LAYERDIR}/recipes-*/*/*/*/*.bb \
            ${LAYERDIR}/recipes-*/*/*/*/*.bbappend"

BBFILE_COLLECTIONS += "nolpi"
BBFILE_PATTERN_nolpi := "^${LAYERDIR}"
BBFILE_PRIORITY_nolpi = "10"

# Yocto project release 2.7 ("warrior")
LAYERSERIES_COMPAT_nolpi = "warrior"
```

## conf/machine/nolpi3.conf
```bitbake
#@TYPE: Machine
#@NAME: RaspberryPi 3 Development Board, Nol Edition
#@DESCRIPTION: Machine configuration for the RaspberryPi 3

# This machine is based on the existing raspberrypi3
require conf/machine/raspberrypi3.conf

###################################
#     Overrides
###################################

SDIMG_KERNELIMAGE = "kernel7.img"
UBOOT_MACHINE = "rpi_3_32b_config"
SERIAL_CONSOLES = "115200;ttyS0"

# Enable U-Boot which shall load the kernel (start.elf will start U-Boot)
RPI_USE_U_BOOT = "1"

# Use zImage (not uImage)
KERNEL_BOOTCMD = "bootz"
KERNEL_IMAGETYPE_UBOOT = "zImage"

# We want the .gz variants to play with U-Boot command gzwrite
IMAGE_FSTYPES = "tar.bz2 ext3.gz rpi-sdimg rpi-sdimg.gz"

# We are only using one specific board
RPI_KERNEL_DEVICETREE = " \
    bcm2710-rpi-3-b-plus.dtb \
"

# Boot partition size [in KiB]
# We can't make it smaller than 33MB, otherwise board will not boot.
# Why? Some magic regarding FAT32 or bootcode.bin / start.elf?
BOOT_SPACE = "33792"
```
